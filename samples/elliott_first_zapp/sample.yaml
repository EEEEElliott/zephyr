## samples/elliott_first_zapp/sample.yaml
```yaml
sample:
  name: Elliott's First Zephyr Sample
tests:
  sample.elliott_first_zapp:
    tags:
      - LED
      - gpio
    filter: dt_enabled_alias_with_parent_compat("led0", "gpio-leds")
    depends_on: gpio
    harness: pytest
    harness_config:
      pytest_args: ["-p","no:embed_test_pytest"]
    integration_platforms:
      - frdm_k64f
      - frdm_mcxw72/mcxw727c/cpu0
```
